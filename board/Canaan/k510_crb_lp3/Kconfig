## board/Canaan/k510_crb_lp3/Kconfig
```kconfig
if TARGET_K510_EVB_LP3_V1_0

config SYS_CPU
	default "ax25"

config SYS_BOARD
	default "k510_evb_lp3"

config SYS_VENDOR
	default "Canaan"

config SYS_SOC
	default "k510"

config SYS_CONFIG_NAME
	default "k510_evb_lp3_v1_0"

config ENV_SIZE
	default 0x2000 if ENV_IS_IN_SPI_FLASH

config ENV_OFFSET
	default 0x140000 if ENV_IS_IN_SPI_FLASH

config SPL_TEXT_BASE
	default 0x800000

config SPL_OPENSBI_LOAD_ADDR
	default 0x01000000

config BOARD_SPECIFIC_OPTIONS # dummy
	def_bool y
	select RISCV_NDS
	select SUPPORT_SPL
	imply SMP
	imply SPL_RAM_SUPPORT
	imply SPL_RAM_DEVICE

endif

if TARGET_K510_EVB_LP3_V1_1

config SYS_CPU
	default "ax25"

config SYS_BOARD
	default "k510_evb_lp3"

config SYS_VENDOR
	default "Canaan"

config SYS_SOC
	default "k510"

config SYS_CONFIG_NAME
	default "k510_evb_lp3_v1_1"

config ENV_SIZE
	default 0x2000 if ENV_IS_IN_SPI_FLASH

config ENV_OFFSET
	default 0x140000 if ENV_IS_IN_SPI_FLASH

config SPL_TEXT_BASE
	default 0x800000

config SPL_OPENSBI_LOAD_ADDR
	default 0x01000000

config BOARD_SPECIFIC_OPTIONS # dummy
	def_bool y
	select RISCV_NDS
	select SUPPORT_SPL
	imply SMP
	imply SPL_RAM_SUPPORT
	imply SPL_RAM_DEVICE

endif


if TARGET_K510_CRB_LP3_V0_1

config SYS_CPU
	default "ax25"

config SYS_BOARD
	default "k510_crb_lp3"

config SYS_VENDOR
	default "Canaan"

config SYS_SOC
	default "k510"

config SYS_CONFIG_NAME
	default "k510_crb_lp3_v0_1"

config ENV_SIZE
	default 0x2000 if ENV_IS_IN_SPI_FLASH

config ENV_OFFSET
	default 0x140000 if ENV_IS_IN_SPI_FLASH

config SPL_TEXT_BASE
	default 0x800000

config SPL_OPENSBI_LOAD_ADDR
	default 0x01000000

config BOARD_SPECIFIC_OPTIONS # dummy
	def_bool y
	select RISCV_NDS
	select SUPPORT_SPL
	imply SMP
	imply SPL_RAM_SUPPORT
	imply SPL_RAM_DEVICE

endif

if TARGET_K510_CRB_LP3_V1_2

config SYS_CPU
	default "ax25"

config SYS_BOARD
	default "k510_crb_lp3"

config SYS_VENDOR
	default "Canaan"

config SYS_SOC
	default "k510"

config SYS_CONFIG_NAME
	default "k510_crb_lp3_v1_2"

config ENV_SIZE
	default 0x2000 if ENV_IS_IN_SPI_FLASH

config ENV_OFFSET
	default 0x140000 if ENV_IS_IN_SPI_FLASH

config SPL_TEXT_BASE
	default 0x800000

config SPL_OPENSBI_LOAD_ADDR
	default 0x01000000

config BOARD_SPECIFIC_OPTIONS # dummy
	def_bool y
	select RISCV_NDS
	select SUPPORT_SPL
	imply SMP
	imply SPL_RAM_SUPPORT
	imply SPL_RAM_DEVICE

endif
```

## board/Canaan/k510_evb_lp4/Kconfig
```kconfig
if TARGET_K510_EVB_LP4

config SYS_CPU
	default "ax25"

config SYS_BOARD
	default "k510_evb_lp4"

config SYS_VENDOR
	default "Canaan"

config SYS_SOC
	default "k510"

config SYS_CONFIG_NAME
	default "k510_evb_lp4"

config ENV_SIZE
	default 0x2000 if ENV_IS_IN_SPI_FLASH

config ENV_OFFSET
	default 0x140000 if ENV_IS_IN_SPI_FLASH

config SPL_TEXT_BASE
	default 0x800000

config SPL_OPENSBI_LOAD_ADDR
	default 0x01000000

config BOARD_SPECIFIC_OPTIONS # dummy
	def_bool y
	select RISCV_NDS
	select SUPPORT_SPL
	imply SMP
	imply SPL_RAM_SUPPORT
	imply SPL_RAM_DEVICE

endif
```

## configs/k510_crb_defconfig
```kconfig
CONFIG_RISCV=y
CONFIG_SYS_TEXT_BASE=0x1200000
CONFIG_SYS_MALLOC_LEN=0x80000
CONFIG_NR_DRAM_BANKS=1
CONFIG_ENV_SECT_SIZE=0x1000
CONFIG_DEFAULT_DEVICE_TREE="k510-br"
CONFIG_SYS_PROMPT="RISC-V # "
CONFIG_SPL_SYS_MALLOC_F_LEN=0x100000
CONFIG_SPL=y
CONFIG_SYS_LOAD_ADDR=0x100000
CONFIG_TARGET_AX25_AE350=y
CONFIG_SPL_OPENSBI_LOAD_ADDR=0x0
CONFIG_ARCH_RV64I=y
CONFIG_RISCV_SMODE=y
CONFIG_DISTRO_DEFAULTS=y
CONFIG_HAS_CUSTOM_SYS_INIT_SP_ADDR=y
CONFIG_CUSTOM_SYS_INIT_SP_ADDR=0xfffe70
CONFIG_FIT=y
CONFIG_SPL_LOAD_FIT_ADDRESS=0x00200000
CONFIG_SYS_MONITOR_BASE=0x88000000
CONFIG_BOOTDELAY=3
CONFIG_BOARD_EARLY_INIT_F=y
CONFIG_SPL_MAX_SIZE=0x100000
CONFIG_SPL_BSS_START_ADDR=0x4000000
CONFIG_SPL_OPENSBI_SCRATCH_OPTIONS=0x0
CONFIG_SYS_PBSIZE=1050
CONFIG_SYS_BOOTM_LEN=0x4000000
CONFIG_CMD_IMLS=y
CONFIG_CMD_MMC=y
CONFIG_CMD_SF_TEST=y
# CONFIG_CMD_SETEXPR is not set
CONFIG_BOOTP_PREFER_SERVERIP=y
CONFIG_CMD_CACHE=y
CONFIG_ENV_OVERWRITE=y
CONFIG_ENV_IS_IN_SPI_FLASH=y
CONFIG_BOOTP_SEND_HOSTNAME=y
CONFIG_NET_RANDOM_ETHADDR=y
CONFIG_MMC=y
CONFIG_MTD_NOR_FLASH=y
CONFIG_FLASH_CFI_DRIVER=y
CONFIG_SYS_FLASH_CFI_WIDTH_16BIT=y
CONFIG_SYS_CFI_FLASH_STATUS_POLL=y
CONFIG_SYS_FLASH_USE_BUFFER_WRITE=y
CONFIG_SYS_FLASH_CFI=y
CONFIG_SPI_FLASH_MACRONIX=y
CONFIG_SYS_NS16550=y
CONFIG_SPI=y
# CONFIG_BINMAN_FDT is not set
```
